
#include <USB_struct.h>

/**************************************************************************************************
                                    ПРОТОТИПЫ ЛОКАЛЬНЫХ ФУНКЦИЙ
**************************************************************************************************/

__IO uint8_t Receive_Buffer[64];
__IO uint8_t Receive_length;
__IO uint8_t Send_Buffer[VIRTUAL_COM_PORT_DATA_SIZE] ;
__IO uint8_t Send_length;


/**************************************************************************************************
                                       ГЛОБАЛЬНЫЕ ПЕРЕМЕННЫЕ
**************************************************************************************************/

usb_struct Usb1 =
{
	.rxCounter	= 0,
	.rxTail			=	0,
	.rxHead			=	0,
	.txCounter	= 0,
};

/**************************************************************************************************
                                        ГЛОБАЛЬНЫЕ ФУНКЦИИ
**************************************************************************************************/

/**************************************************************************************************
Описание:  Возвращает очередной байт из буфера приемника UART
Аргументы: Указатель на структуру UART
Возврат:   Байт данных
Замечания: Изменяет счетчик принятых байт 
**************************************************************************************************/
uint8_t GetByteFromUsb( usb_struct * usb )
{
	uint8_t dataByte;

	dataByte = usb->rxBuf[ usb->rxTail ]; 
	usb->rxTail++;
	usb->rxTail %= RX_BUFFER_SIZE;
		
	ENTER_CRITICAL_SECTION();
	
		usb->rxCounter--;
		
	LEAVE_CRITICAL_SECTION();	
		
	return dataByte; 	
}



/**************************************************************************************************
Описание:  Возвращает состояние буфера приемника
Аргументы: Указатель на структуру UART
Возврат:   true, если есть необработанные байты
Замечания: 
**************************************************************************************************/
bool IsNewDataInUsb( usb_struct * usb )
{
	if ( usb->rxCounter )
	{
		return true;
	}
	else
	{
		return false;
	}
}



/**************************************************************************************************
Описание:  Инициализация процесса отправки сообщения по UART
Аргументы: Указатель на структуру UART, указатель на буффер, длина
Возврат:   Нет
Замечания: 
**************************************************************************************************/
void SendDataToUsb( usb_struct * usb, uint8_t *buffer, uint16_t size )
{
	usb->txBufPtr = buffer;
	usb->txCounter = size;
}

void CopyDataFromReceiveToUsb( usb_struct * usb )
{
	if( Receive_length > 0 )
	{
 		if ( usb->rxCounter < RX_BUFFER_SIZE  )
 		{ 
			for (uint8_t i = 0; i < Receive_length; ++i)
			{
				usb->rxBuf[ usb->rxHead ] = Receive_Buffer[i];
				usb->rxHead++;
				usb->rxHead %= RX_BUFFER_SIZE;
				usb->rxCounter++;
			}
 		}
 		else
 		{
			usb->rxCounter = 0;
			usb->rxTail = 0;
			usb->rxHead = 0;
 		}
		Receive_length = 0;
	}
}

void CopyDataFromUsbToSend( usb_struct * usb )
{
 	while ( usb->txCounter )	
 	{
		usb->txCounter--;
		Send_Buffer[Send_length] = *(usb->txBufPtr++);
		Send_length++;
 	}
}

/**************************************************************************************************
                                       ЛОКАЛЬНЫЕ ФУНКЦИИ
**************************************************************************************************/


